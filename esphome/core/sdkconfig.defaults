## esphome/core/sdkconfig.defaults
```kconfig
# CONFIG_AUTOCONNECT_WIFI is not set
# CONFIG_BLE_ACTIVE_SCAN_REPORT_ADV_SCAN_RSP_INDIVIDUALLY is not set
# CONFIG_BLE_HOST_QUEUE_CONGESTION_CHECK is not set
# CONFIG_BLE_MESH_SCAN_DUPLICATE_EN is not set
# CONFIG_BLUEDROID_MEM_DEBUG is not set
# CONFIG_BLUEDROID_PINNED_TO_CORE_1 is not set
# CONFIG_BOOTLOADER_LOG_LEVEL_INFO is not set
# CONFIG_BTDM_BLE_MESH_SCAN_DUPL_EN is not set
# CONFIG_BTDM_COEX_BT_OPTIONS is not set
# CONFIG_BTDM_CONTROLLER_HCI_MODE_UART_H4 is not set
# CONFIG_BTDM_CONTROLLER_MODE_BLE_ONLY is not set
# CONFIG_BTDM_CONTROLLER_MODE_BR_EDR_ONLY is not set
# CONFIG_BTDM_CTRL_AUTO_LATENCY is not set
# CONFIG_BTDM_CTRL_BR_EDR_SCO_DATA_PATH_HCI is not set
# CONFIG_BTDM_CTRL_HCI_MODE_UART_H4 is not set
# CONFIG_BTDM_CTRL_MODE_BLE_ONLY is not set
# CONFIG_BTDM_CTRL_MODE_BR_EDR_ONLY is not set
# CONFIG_BTDM_CTRL_PINNED_TO_CORE_1 is not set
# CONFIG_BTDM_MODEM_SLEEP_MODE_EVED is not set
# CONFIG_BTDM_SCAN_DUPL_TYPE_DATA is not set
# CONFIG_BTDM_SCAN_DUPL_TYPE_DATA_DEVICE is not set
# CONFIG_BT_BLE_ACT_SCAN_REP_ADV_SCAN is not set
# CONFIG_BT_BLE_HOST_QUEUE_CONG_CHECK is not set
# CONFIG_BT_BLUEDROID_MEM_DEBUG is not set
# CONFIG_BT_BLUEDROID_PINNED_TO_CORE_1 is not set
# CONFIG_BT_CONTROLLER_ONLY is not set
# CONFIG_BT_GATTC_CACHE_NVS_FLASH is not set
# CONFIG_BT_GATTS_SEND_SERVICE_CHANGE_MANUAL is not set
# CONFIG_BT_HFP_AUDIO_DATA_PATH_HCI is not set
# CONFIG_BT_NIMBLE_ENABLED is not set
# CONFIG_BT_SMP_SLAVE_CON_PARAMS_UPD_ENABLE is not set
# CONFIG_CAMERA_CORE0 is not set
# CONFIG_CAMERA_NO_AFFINITY is not set
# CONFIG_COMPILER_STACK_CHECK_MODE_NONE is not set
# CONFIG_C_IMPL is not set
# CONFIG_ESP32_DEFAULT_CPU_FREQ_160 is not set
# CONFIG_ESP32_WIFI_RX_IRAM_OPT is not set
# CONFIG_ESP32_XTAL_FREQ_40 is not set
# CONFIG_ESPTOOLPY_BAUD_115200B is not set
# CONFIG_ESPTOOLPY_BAUD_230400B is not set
# CONFIG_ESPTOOLPY_BAUD_2MB is not set
# CONFIG_ESPTOOLPY_BAUD_OTHER is not set
# CONFIG_ESPTOOLPY_FLASHSIZE_2MB is not set
# CONFIG_ESP_TASK_WDT_CHECK_IDLE_TASK_CPU1 is not set
# CONFIG_FATFS_API_ENCODING_UTF_16 is not set
# CONFIG_FATFS_API_ENCODING_UTF_8 is not set
# CONFIG_FATFS_CODEPAGE_437 is not set
# CONFIG_FATFS_LFN_NONE is not set
# CONFIG_FREERTOS_ASSERT_ON_UNTESTED_FUNCTION is not set
# CONFIG_FRMN is not set
# CONFIG_GATTC_CACHE_NVS_FLASH is not set
# CONFIG_GATTS_SEND_SERVICE_CHANGE_MANUAL is not set
# CONFIG_HEAP_POISONING_DISABLED is not set
# CONFIG_HEAP_TASK_TRACKING is not set
# CONFIG_HFP_AUDIO_DATA_PATH_HCI is not set
# CONFIG_LOG_BOOTLOADER_LEVEL_INFO is not set
# CONFIG_LOG_COLORS is not set
# CONFIG_LOG_DEFAULT_LEVEL_INFO is not set
# CONFIG_LSSH_WITH_LANDMARK is not set
# CONFIG_LWIP_DHCP_DOES_ARP_CHECK is not set
# CONFIG_LWIP_IP_FRAG is not set
# CONFIG_LWIP_PPP_DEBUG_ON is not set
# CONFIG_LWIP_PPP_NOTIFY_PHASE_SUPPORT is not set
# CONFIG_LWIP_TCPIP_TASK_AFFINITY_NO_AFFINITY is not set
# CONFIG_MBEDTLS_ASYMMETRIC_CONTENT_LEN is not set
# CONFIG_MBEDTLS_EXTERNAL_MEM_ALLOC is not set
# CONFIG_MBEDTLS_HARDWARE_SHA is not set
# CONFIG_MFN56_2X is not set
# CONFIG_MFN56_3X is not set
# CONFIG_MFN56_4X is not set
# CONFIG_MTMN_HEAVY_QUANT is not set
# CONFIG_MTMN_LITE_FLOAT is not set
# CONFIG_NIMBLE_ENABLED is not set
# CONFIG_OPENSSL_ASSERT_EXIT is not set
# CONFIG_PPP_DEBUG_ON is not set
# CONFIG_PPP_NOTIFY_PHASE_SUPPORT is not set
# CONFIG_SCAN_DUPLICATE_BY_ADV_DATA is not set
# CONFIG_SCAN_DUPLICATE_BY_ADV_DATA_AND_DEVICE_ADDR is not set
# CONFIG_SCCB_HARDWARE_I2C_PORT0 is not set
# CONFIG_SMP_SLAVE_CON_PARAMS_UPD_ENABLE is not set
# CONFIG_SPIRAM_2T_MODE is not set
# CONFIG_SPIRAM_ALLOW_BSS_SEG_EXTERNAL_MEMORY is not set
# CONFIG_SPIRAM_BOOT_INIT is not set
# CONFIG_SPIRAM_TRY_ALLOCATE_WIFI_LWIP is not set
# CONFIG_SPIRAM_TYPE_ESPPSRAM32 is not set
# CONFIG_SPIRAM_TYPE_ESPPSRAM64 is not set
# CONFIG_SPIRAM_USE_MALLOC is not set
# CONFIG_SPIRAM_USE_MEMMAP is not set
# CONFIG_STACK_CHECK_NONE is not set
# CONFIG_TASK_WDT_CHECK_IDLE_TASK_CPU1 is not set
# CONFIG_TCPIP_TASK_AFFINITY_NO_AFFINITY is not set
# CONFIG_WIFI_LWIP_ALLOCATION_FROM_SPIRAM_FIRST is not set
# End of deprecated options
CONFIG_A2DP_ENABLE=y
CONFIG_ARDUHAL_ESP_LOG=y
CONFIG_AUTOSTART_ARDUINO=y
CONFIG_BLE_ADV_REPORT_DISCARD_THRSHOLD=20
CONFIG_BLE_ADV_REPORT_FLOW_CONTROL_NUM=100
CONFIG_BLE_ADV_REPORT_FLOW_CONTROL_SUPPORTED=y
CONFIG_BLE_ESTABLISH_LINK_CONNECTION_TIMEOUT=30
CONFIG_BLE_SCAN_DUPLICATE=y
CONFIG_BLE_SMP_ENABLE=y
CONFIG_BLUEDROID_ENABLED=y
CONFIG_BLUEDROID_PINNED_TO_CORE=0
CONFIG_BLUEDROID_PINNED_TO_CORE_0=y
CONFIG_BOOTLOADER_LOG_LEVEL=0
CONFIG_BOOTLOADER_LOG_LEVEL_NONE=y
CONFIG_BTC_TASK_STACK_SIZE=8192
CONFIG_BTDM_BLE_ADV_REPORT_DISCARD_THRSHOLD=20
CONFIG_BTDM_BLE_ADV_REPORT_FLOW_CTRL_NUM=100
CONFIG_BTDM_BLE_ADV_REPORT_FLOW_CTRL_SUPP=y
CONFIG_BTDM_BLE_DEFAULT_SCA_250PPM=y
CONFIG_BTDM_BLE_SCAN_DUPL=y
CONFIG_BTDM_CONTROLLER_BLE_MAX_CONN=3
CONFIG_BTDM_CONTROLLER_BLE_MAX_CONN_EFF=3
CONFIG_BTDM_CONTROLLER_BR_EDR_MAX_ACL_CONN=2
CONFIG_BTDM_CONTROLLER_BR_EDR_MAX_ACL_CONN_EFF=2
CONFIG_BTDM_CONTROLLER_BR_EDR_MAX_SYNC_CONN=0
CONFIG_BTDM_CONTROLLER_FULL_SCAN_SUPPORTED=y
CONFIG_BTDM_CONTROLLER_HCI_MODE_VHCI=y
CONFIG_BTDM_CONTROLLER_MODEM_SLEEP=y
CONFIG_BTDM_CONTROLLER_MODE_BTDM=y
CONFIG_BTDM_CTRL_BLE_MAX_CONN=3
CONFIG_BTDM_CTRL_BLE_MAX_CONN_EFF=3
CONFIG_BTDM_CTRL_BR_EDR_MAX_ACL_CONN=2
CONFIG_BTDM_CTRL_BR_EDR_MAX_ACL_CONN_EFF=2
CONFIG_BTDM_CTRL_BR_EDR_MAX_SYNC_CONN=0
CONFIG_BTDM_CTRL_BR_EDR_SCO_DATA_PATH_EFF=1
CONFIG_BTDM_CTRL_BR_EDR_SCO_DATA_PATH_PCM=y
CONFIG_BTDM_CTRL_FULL_SCAN_SUPPORTED=y
CONFIG_BTDM_CTRL_HCI_MODE_VHCI=y
CONFIG_BTDM_CTRL_MODE_BTDM=y
CONFIG_BTDM_CTRL_PINNED_TO_CORE_0=y
CONFIG_BTDM_LPCLK_SEL_MAIN_XTAL=y
CONFIG_BTDM_MODEM_SLEEP=y
CONFIG_BTDM_MODEM_SLEEP_MODE_ORIG=y
CONFIG_BTDM_SCAN_DUPL_CACHE_SIZE=20
CONFIG_BTDM_SCAN_DUPL_TYPE=0
CONFIG_BTDM_SCAN_DUPL_TYPE_DEVICE=y
CONFIG_BTU_TASK_STACK_SIZE=4096
CONFIG_BT_A2DP_ENABLE=y
CONFIG_BT_ACL_CONNECTIONS=4
CONFIG_BT_ALLOCATION_FROM_SPIRAM_FIRST=y
CONFIG_BT_BLE_DYNAMIC_ENV_MEMORY=y
CONFIG_BT_BLE_ENABLED=y
CONFIG_BT_BLE_ESTAB_LINK_CONN_TOUT=30
CONFIG_BT_BLE_SMP_ENABLE=y
CONFIG_BT_BLUEDROID_ENABLED=y
CONFIG_BT_BLUEDROID_PINNED_TO_CORE=0
CONFIG_BT_BLUEDROID_PINNED_TO_CORE_0=y
CONFIG_BT_BTC_TASK_STACK_SIZE=8192
CONFIG_BT_BTU_TASK_STACK_SIZE=4096
CONFIG_BT_CLASSIC_ENABLED=y
CONFIG_BT_ENABLED=y
CONFIG_BT_GATTC_ENABLE=y
CONFIG_BT_GATTS_ENABLE=y
CONFIG_BT_GATTS_SEND_SERVICE_CHANGE_AUTO=y
CONFIG_BT_GATTS_SEND_SERVICE_CHANGE_MODE=0
CONFIG_BT_HFP_AUDIO_DATA_PATH_PCM=y
CONFIG_BT_HFP_CLIENT_ENABLE=y
CONFIG_BT_HFP_ENABLE=y
CONFIG_BT_RESERVE_DRAM=0xdb5c
CONFIG_BT_SMP_ENABLE=y
CONFIG_BT_SPP_ENABLED=y
CONFIG_BT_SSP_ENABLED=y
CONFIG_BT_STACK_NO_LOG=y
CONFIG_CAMERA_CORE1=y
CONFIG_CLASSIC_BT_ENABLED=y
CONFIG_COMPILER_CXX_EXCEPTIONS=y
CONFIG_COMPILER_CXX_EXCEPTIONS_EMG_POOL_SIZE=0
CONFIG_COMPILER_STACK_CHECK=y
CONFIG_COMPILER_STACK_CHECK_MODE_NORM=y
CONFIG_COMPILER_WARN_WRITE_STRINGS=y
CONFIG_CXX_EXCEPTIONS=y
CONFIG_CXX_EXCEPTIONS_EMG_POOL_SIZE=0
CONFIG_D0WD_PSRAM_CLK_IO=17
CONFIG_D0WD_PSRAM_CS_IO=16
CONFIG_D2WD_PSRAM_CLK_IO=9
CONFIG_D2WD_PSRAM_CS_IO=10
CONFIG_DUPLICATE_SCAN_CACHE_SIZE=20
CONFIG_ESP32_DEFAULT_CPU_FREQ_240=y
CONFIG_ESP32_DEFAULT_CPU_FREQ_MHZ=240
CONFIG_ESP32_PTHREAD_TASK_STACK_SIZE_DEFAULT=2048
CONFIG_ESP32_SPIRAM_SUPPORT=y
CONFIG_ESP32_ULP_COPROC_ENABLED=y
CONFIG_ESP32_ULP_COPROC_RESERVE_MEM=512
CONFIG_ESP32_WIFI_RX_BA_WIN=16
CONFIG_ESP32_WIFI_STATIC_RX_BUFFER_NUM=16
CONFIG_ESP32_WIFI_SW_COEXIST_ENABLE=y
CONFIG_ESP32_XTAL_FREQ=0
CONFIG_ESP32_XTAL_FREQ_AUTO=y
CONFIG_ESPTOOLPY_BAUD=921600
CONFIG_ESPTOOLPY_BAUD_921600B=y
CONFIG_ESPTOOLPY_COMPRESSED=y
CONFIG_ESPTOOLPY_FLASHSIZE="4MB"
CONFIG_ESPTOOLPY_FLASHSIZE_4MB=y
CONFIG_ESPTOOLPY_PORT="/dev/cu.usbserial-DO00EAB0"
CONFIG_ESP_MAIN_TASK_STACK_SIZE=4096
CONFIG_ESP_SYSTEM_EVENT_TASK_STACK_SIZE=2048
CONFIG_ESP_TASK_WDT_PANIC=y
CONFIG_ESP_TIMER_TASK_STACK_SIZE=4096
CONFIG_FATFS_ALLOC_PREFER_EXTRAM=y
CONFIG_FATFS_API_ENCODING_ANSI_OEM=y
CONFIG_FATFS_CODEPAGE=850
CONFIG_FATFS_CODEPAGE_850=y
CONFIG_FATFS_LFN_STACK=y
CONFIG_FATFS_MAX_LFN=255
CONFIG_FREERTOS_HZ=1000
CONFIG_FREERTOS_IDLE_TASK_STACKSIZE=1024
CONFIG_FREERTOS_WATCHPOINT_END_OF_STACK=y
CONFIG_GATTC_ENABLE=y
CONFIG_GATTS_ENABLE=y
CONFIG_GATTS_SEND_SERVICE_CHANGE_AUTO=y
CONFIG_GATTS_SEND_SERVICE_CHANGE_MODE=0
CONFIG_HEAP_POISONING_LIGHT=y
CONFIG_HFP_AUDIO_DATA_PATH_PCM=y
CONFIG_HFP_CLIENT_ENABLE=y
CONFIG_HFP_ENABLE=y
CONFIG_LIBSODIUM_USE_MBEDTLS_SHA=y
CONFIG_LOG_BOOTLOADER_LEVEL=0
CONFIG_LOG_BOOTLOADER_LEVEL_NONE=y
CONFIG_LOG_DEFAULT_LEVEL=1
CONFIG_LOG_DEFAULT_LEVEL_ERROR=y
CONFIG_LSSH_SPARSE_MN_5=y
CONFIG_LWIP_DHCP_RESTORE_LAST_IP=y
CONFIG_LWIP_ETHARP_TRUST_IP_MAC=y
CONFIG_LWIP_PPP_CHAP_SUPPORT=y
CONFIG_LWIP_PPP_MPPE_SUPPORT=y
CONFIG_LWIP_PPP_MSCHAP_SUPPORT=y
CONFIG_LWIP_PPP_PAP_SUPPORT=y
CONFIG_LWIP_PPP_SUPPORT=y
CONFIG_LWIP_TCPIP_TASK_AFFINITY=0x0
CONFIG_LWIP_TCPIP_TASK_AFFINITY_CPU0=y
CONFIG_LWIP_TCPIP_TASK_STACK_SIZE=2560
CONFIG_LWIP_TCP_MSS=1436
CONFIG_MAIN_TASK_STACK_SIZE=4096
CONFIG_MAKE_WARN_UNDEFINED_VARIABLES=y
CONFIG_MBEDTLS_KEY_EXCHANGE_DHE_PSK=y
CONFIG_MBEDTLS_KEY_EXCHANGE_ECDHE_PSK=y
CONFIG_MBEDTLS_KEY_EXCHANGE_PSK=y
CONFIG_MBEDTLS_KEY_EXCHANGE_RSA_PSK=y
CONFIG_MBEDTLS_PSK_MODES=y
CONFIG_MBEDTLS_SSL_MAX_CONTENT_LEN=16384
CONFIG_MFN56_1X=y
CONFIG_MTMN_LITE_QUANT=y
CONFIG_OPENSSL_ASSERT_DO_NOTHING=y
CONFIG_OV2640_SUPPORT=y
CONFIG_OV3660_SUPPORT=y
CONFIG_OV5640_SUPPORT=y
CONFIG_OV7725_SUPPORT=y
CONFIG_PICO_PSRAM_CS_IO=10
CONFIG_PPP_CHAP_SUPPORT=y
CONFIG_PPP_MPPE_SUPPORT=y
CONFIG_PPP_MSCHAP_SUPPORT=y
CONFIG_PPP_PAP_SUPPORT=y
CONFIG_PPP_SUPPORT=y
CONFIG_PTHREAD_TASK_STACK_SIZE_DEFAULT=2048
CONFIG_PYTHON="python"
CONFIG_SCAN_DUPLICATE_BY_DEVICE_ADDR=y
CONFIG_SCAN_DUPLICATE_TYPE=0
CONFIG_SCCB_HARDWARE_I2C=y
CONFIG_SCCB_HARDWARE_I2C_PORT1=y
CONFIG_SDK_MAKE_WARN_UNDEFINED_VARIABLES=y
CONFIG_SDK_PYTHON="python"
CONFIG_SMP_ENABLE=y
CONFIG_SPIRAM_BANKSWITCH_ENABLE=y
CONFIG_SPIRAM_BANKSWITCH_RESERVE=8
CONFIG_SPIRAM_CACHE_WORKAROUND=y
CONFIG_SPIRAM_SIZE=-1
CONFIG_SPIRAM_SPEED_40M=y
CONFIG_SPIRAM_SPIWP_SD3_PIN=7
CONFIG_SPIRAM_SUPPORT=y
CONFIG_SPIRAM_TYPE_AUTO=y
CONFIG_SPIRAM_USE_CAPS_ALLOC=y
CONFIG_STACK_CHECK=y
CONFIG_STACK_CHECK_NORM=y
CONFIG_SW_COEXIST_ENABLE=y
CONFIG_SYSTEM_EVENT_TASK_STACK_SIZE=2048
CONFIG_TASK_WDT_PANIC=y
CONFIG_TCPIP_TASK_AFFINITY=0x0
CONFIG_TCPIP_TASK_AFFINITY_CPU0=y
CONFIG_TCPIP_TASK_STACK_SIZE=2560
CONFIG_TCP_MSS=1436
CONFIG_TIMER_TASK_STACK_SIZE=4096
CONFIG_ULP_COPROC_ENABLED=y
CONFIG_ULP_COPROC_RESERVE_MEM=512
CONFIG_WARN_WRITE_STRINGS=y
CONFIG_XTENSA_IMPL=y
CONFIG_PM_ENABLE=y
CONFIG_FREERTOS_USE_TICKLESS_IDLE=y
CONFIG_FREERTOS_IDLE_TIME_BEFORE_SLEEP=3
```
